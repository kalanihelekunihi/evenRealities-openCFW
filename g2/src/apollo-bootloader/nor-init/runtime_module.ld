ENTRY(opencfw_provider_41fe28)
SECTIONS { . = 0x10000; .text : { *(.text*) *(.rodata*) } /DISCARD/ : { *(.ARM.exidx*) *(.ARM.extab*) *(.comment*) } }
opencfw_hal_power_control = 0x426809;
opencfw_provider_416610 = 0x416611;
opencfw_provider_4176ce = 0x4176cf;
