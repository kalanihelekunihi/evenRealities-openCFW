ENTRY(case_binary_linked_entry)
case_binary_14_send = 0x0010f041;
case_binary_3d_control = 0x0010f061;
case_binary_3d_logger = 0x0010f0a1;
case_binary_3e_ack = 0x0010f0c1;
case_binary_3e_control = 0x0010f0e1;
case_binary_3e_logger = 0x0010f101;
case_binary_3f_ack = 0x0010f121;
case_binary_3f_bus = 0x0010f141;
case_binary_3f_program_log = 0x0010f401;
case_binary_3f_logger = 0x0010f161;
case_binary_56_ack = 0x0010f181;
case_binary_56_cancel = 0x0010f421;
case_binary_56_clear_a = 0x0010f441;
case_binary_56_clear_b = 0x0010f461;
case_binary_56_exit_log = 0x0010f481;
case_binary_56_logger = 0x0010f1c1;
case_binary_5e_ack = 0x0010f1e1;
case_binary_5e_apply = 0x0010f201;
case_binary_5e_hex = 0x0010f221;
case_binary_5e_logger = 0x0010f241;
case_binary_5e_send = 0x0010f261;
case_binary_forward_control = 0x0010f281;
case_binary_local_ack = 0x0010f2c1;
case_binary_local_control_a = 0x0010f2e1;
case_binary_local_control_b = 0x0010f301;
case_binary_local_send = 0x0010f321;
case_binary_logger = 0x0010f341;
case_binary_sensor_transaction = 0x0010f361;
case_binary_sensor_delay_count = 0x0010f381;
case_binary_send51 = 0x0010f3a1;
case_binary_send5f = 0x0010f3c1;
SECTIONS { . = 0x00100000; .text : { *(.text*) *(.rodata*) } /DISCARD/ : { *(.ARM.exidx*) *(.ARM.extab*) *(.comment*) } }
