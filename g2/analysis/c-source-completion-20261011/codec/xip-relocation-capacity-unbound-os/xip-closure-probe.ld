SECTIONS {
 .gx8002_xip_closure 0x10203004 : {
  *(.text.g2_codec_gpio_set_level)
  *(.text.g2_codec_event_prepare)
  *(.text.g2_codec_event_dispatch)
  *(.text.g2_codec_event_91_helper)
  *(.text.g2_codec_construct_request)
  *(.text.g2_codec_audio_board_get)
  *(.text.g2_codec_audio_board_gain)
  *(.text.g2_codec_dw_uart_dma_burst)
  *(.text.g2_codec_dw_uart_putc)
  *(.text.g2_codec_dw_uart_getc)
  *(.text.g2_codec_channel_lookup)
  *(.text.g2_codec_request_consume)
  *(.text.g2_codec_queue_is_full)
  *(.text.g2_codec_queue_is_empty)
  *(.text.g2_codec_queue_read)
  *(.text.g2_codec_uart_message_start)
  *(.text.gx8002_xip_uart_message_start_10207adc)
  *(.text.g2_codec_channel_callback_set)
  *(.text.g2_codec_channel_stop)
  *(.text.g2_codec_channel_timer_start)
  *(.text.g2_codec_critical_save)
  *(.text.g2_codec_critical_restore)
  *(.text.g2_codec_header_sync)
  *(.text.g2_codec_queue_enqueue)
  *(.text.g2_codec_timestamp)
  *(.text.gx8002_xip_memset_102099cc)
  *(.text.gx8002_xip_tws_dequeue_10206fb0)
  *(.text.gx8002_xip_tws_ack_102073a0)
  *(.text.gx8002_xip_tws_ready_102077f8)
  *(.text.gx8002_xip_tws_dispatch_10208cc0)
  *(.text.gx8002_xip_tws_clock_10206e9c)
  *(.text.gx8002_xip_tws_context_10206ec8)
  *(.text.gx8002_xip_tws_item_10206f08)
  *(.text.gx8002_xip_tws_mode_10207394)
  *(.text.gx8002_xip_tws_buffer_10206ea4)
  *(.text.gx8002_xip_tws_frame_10206eac)
  *(.text.gx8002_xip_tws_frame_count_10206f50)
  *(.text.gx8002_xip_tws_frames_per_channel_10206f74)
  *(.text.gx8002_xip_tws_context_gap_10206f80)
  *(.text.gx8002_xip_tws_context_count_10206f84)
  *(.text.gx8002_xip_tws_event_init_10208c28)
  *(.text.gx8002_xip_tws_event_pointer_10208c68)
  *(.text.gx8002_xip_tws_next_pointer_10208c6c)
  *(.text.gx8002_xip_tws_event_length_10208c74)
  *(.text.gx8002_xip_tws_shift_10206c44)
  *(.text.gx8002_xip_audio_vad_weight_102045f4)
  *(.text.gx8002_xip_audio_vad_curve1_10204630)
  *(.text.gx8002_xip_audio_vad_curve2_10204664)
  *(.text.gx8002_xip_audio_vad_curve3_10204698)
  *(.text.gx8002_xip_audio_vad_curve4_102046d8)
  *(.text.gx8002_xip_audio_vad_curve5_1020470c)
  *(.text.gx8002_xip_audio_vad_chipping_1020472c)
  *(.text.gx8002_xip_audio_vad_state_1020477c)
  *(.text.gx8002_xip_audio_noise_102047ac)
  *(.text.gx8002_xip_audio_vad_query_10207404)
  *(.text.gx8002_xip_tws_commit_102075c8)
  *(.text.gx8002_xip_kws_strategy_reset_10208964)
  *(.text.gx8002_xip_tws_event_102088f8)
  *(.text.gx8002_xip_lvp_init_mode_102085a4)
  *(.text.gx8002_xip_queue_initialize_10206f9c)
  *(.text.gx8002_xip_idle_done_10208624)
  *(.text.gx8002_xip_idle_initialize_10208634)
  *(.text.gx8002_xip_tws_buffer_initialize_10208644)
  *(.text.gx8002_xip_tws_done_1020864c)
  *(.text.gx8002_xip_tws_initialize_10208670)
  *(.text.gx8002_xip_app_resume_10208c7c)
  *(.text.gx8002_xip_app_watchdog_callback_10208c98)
  *(.text.gx8002_xip_app_suspend_10208ca0)
  *(.text.gx8002_xip_app_initialize_10208cd4)
  *(.text.register_pair)
  *(.text.gx8002_xip_register_suspend_102076c0)
  *(.text.gx8002_xip_register_resume_10207718)
  *(.text.gx8002_xip_watchdog_interrupt_10206704)
  *(.text.gx8002_xip_watchdog_initialize_10206720)
  *(.text.gx8002_xip_watchdog_stop_102067ac)
  *(.text.gx8002_xip_reboot_102067b8)
  *(.text.gx8002_xip_kws_initialize_10206d90)
  *(.text.gx8002_xip_kws_done_10206dac)
  *(.text.gx8002_xip_snpu_initialize_10205cf4)
  *(.text.gx8002_xip_snpu_exit_10205d40)
  *(.text.gx8002_xip_snpu_device_initialize_102055a8)
  *(.text.gx8002_xip_snpu_device_exit_102055ac)
  *(.text.gx8002_xip_snpu_request_irq_102055b0)
  *(.text.gx8002_xip_snpu_tcb_initialize_102058d4)
  *(.text.gx8002_xip_snpu_suspend_10205a90)
  *(.text.gx8002_xip_npu_disable_10205600)
  *(.text.gx8002_xip_npu_is_enabled_1020560c)
  *(.text.gx8002_xip_npu_all_idle_102056e4)
  *(.text.gx8002_xip_set_snpu_task_10208c14)
  *(.text.gx8002_xip_kws_flash_load_10206cb0)
  *(.text.gx8002_xip_model_cmd_size_10208bf4)
  *(.text.gx8002_xip_model_weight_size_10208bfc)
  *(.text.gx8002_xip_model_ops_size_10208c04)
  *(.text.gx8002_xip_model_data_size_10208c08)
  *(.text.gx8002_xip_model_tmp_size_10208c10)
  *(.text.gx8002_xip_audio_input_irq_10207020)
  *(.text.gx8002_xip_audio_input_initialize_102073bc)
  *(.text.gx8002_xip_audio_input_done_102073f8)
  *(.text.gx8002_xip_audio_exit_10204984)
  *(.text.gx8002_xip_ain_reset_10203c88)
  *(.text.gx8002_xip_audio_initialize_102047e4)
  *(.text.gx8002_xip_audio_input_config_10207234)
  *(.text.gx8002_xip_audio_board_get_10203004)
  *(.text.gx8002_xip_audio_board_gain_1020300c)
  *(.text.gx8002_xip_audio_board_initialize_10203024)
  *(.text.gx8002_xip_audio_set_i2s_clock_10204320)
  *(.text.gx8002_xip_audio_set_i2sin_mode_10204330)
  *(.text.gx8002_xip_audio_set_dc_enable_10204350)
  *(.text.gx8002_xip_audio_set_rough_gain_102043ac)
  *(.text.gx8002_xip_audio_set_input_channel_10203f70)
  *(.text.gx8002_xip_audio_pga_gain_102042d4)
  *(.text.gx8002_xip_audio_set_fftvad_enable_10204570)
  *(.text.gx8002_xip_audio_input_pdm_10203e7c)
  *(.text.gx8002_xip_audio_input_i2s_10203ec8)
  *(.text.gx8002_xip_audio_input_sadc_10203e18)
  *(.text.gx8002_xip_analog_pga_itrim_10205e34)
  *(.text.gx8002_xip_analog_pga_bypass_10205e50)
  *(.text.gx8002_xip_analog_pga_enable_10205e68)
  *(.text.gx8002_xip_analog_adc_sample_clk_10205e80)
  *(.text.gx8002_xip_analog_adc_out_clk_10205e98)
  *(.text.gx8002_xip_analog_adc_input_select_10205eb0)
  *(.text.gx8002_xip_analog_adc_rstn_10205ec8)
  *(.text.gx8002_xip_audio_set_evad_enable_102043fc)
  *(.text.gx8002_xip_audio_set_evad_threshold_102044e0)
  *(.text.gx8002_xip_mic_buffer_addr_10206e6c)
  *(.text.gx8002_xip_mic_buffer_size_10206e78)
  *(.text.gx8002_xip_logfbank_buffer_addr_10206e84)
  *(.text.gx8002_xip_logfbank_buffer_size_10206e90)
  *(.text.gx8002_xip_pcm_frame_size_10206f5c)
  *(.text.gx8002_xip_mic_channel_count_10206f90)
  *(.text.gx8002_xip_audio_input_buffer_size_10207024)
  *(.text.gx8002_xip_audio_input_buffer_addr_1020704c)
  *(.text.gx8002_xip_audio_input_output_10207070)
  *(.text.gx8002_xip_audio_set_i2sout_mode_10204340)
  *(.text.gx8002_xip_audio_set_logfbank_enable_1020452c)
  *(.text.gx8002_xip_pcm_channel_setting_10203dc8)
  *(.text.gx8002_xip_audio_output_pcm_10203fa8)
  *(.text.gx8002_xip_audio_output_logfbank_10204080)
  *(.text.gx8002_xip_audio_output_spectrum_1020412c)
  *(.text.gx8002_xip_audio_output_i2s_10204228)
  *(.text.gx8002_xip_audio_set_interrupt_enable_102047b8)
  *(.text.gx8002_xip_audio_standby_startup_10207660)
  *(.text.gx8002_xip_buffer_initialize_10206dc0)
  *(.text.gx8002_xip_ctc_offset_clear_10208b64)
  *(.text.gx8002_xip_idle_tick_1020861c)
  *(.text.gx8002_xip_idle_buffer_initialize_10208620)
  *(.text.gx8002_xip_kws_strategy_initialize_10208978)
  *(.text.gx8002_xip_max_kws_initialize_10208944)
  *(.text.gx8002_xip_tws_submit_10205d60)
  *(.text.gx8002_xip_snpu_resume_internal_1020599c)
  *(.text.gx8002_xip_register_set_bit_102055cc)
  *(.text.gx8002_xip_npu_reset_10205880)
  *(.text.gx8002_xip_npu_registers_initialize_10205950)
  *(.text.interrupt_bits)
  *(.text.gx8002_xip_register_clear_bit_102055dc)
  *(.text.gx8002_xip_register_read_102055ec)
  *(.text.gx8002_xip_register_write_102055f0)
  *(.text.gx8002_xip_npu_set_clock_gate_10205618)
  *(.text.gx8002_xip_npu_set_idle_mode_10205630)
  *(.text.gx8002_xip_npu_set_idle_cycle_10205648)
  *(.text.gx8002_xip_npu_set_overtime_10205660)
  *(.text.gx8002_xip_npu_enable_interrupt_1020566c)
  *(.text.gx8002_xip_npu_clear_interrupt_10205768)
  *(.text.gx8002_xip_snpu_submit_task_10205a00)
  *(.text.gx8002_xip_npu_enable_102055f4)
  *(.text.gx8002_xip_npu_get_over_command_10205860)
  *(.text.gx8002_xip_npu_set_task_head_10205898)
  *(.text.gx8002_xip_snpu_task_cache_flush_102059e8)
  *(.text.gx8002_xip_main_exit_10207a7c)
  *(.text.gx8002_xip_audio_suspend_10207644)
  *(.text.gx8002_xip_snpu_get_state_10205e28)
  *(.text.gx8002_xip_tws_command_10207808)
  *(.text.gx8002_xip_tws_publish_10206c24)
  *(.text.gx8002_tfp_putchw.isra.1)
  *(.text.gx8002_xip_tfp_format_10206a84)
  *(.text.gx8002_xip_uart_putc_102035b4)
  *(.text.gx8002_xip_console_putc_102037f0)
  *(.text.gx8002_xip_kws_strategy_10208a10)
  *(.text.gx8002_xip_lvp_system_initialize_102078a4)
  *(.text.gx8002_xip_rtc_isr_10206680)
  *(.text.gx8002_xip_cache_initialize_10203c40)
  *(.text.gx8002_xip_console_initialize_102037e0)
  *(.text.gx8002_xip_gpio_initialize_102060d0)
  *(.text.gx8002_xip_device_list_initialize_102060e8)
  *(.text.gx8002_xip_rtc_start_tick_102066a0)
  *(.text.gx8002_xip_rtc_set_tick_102066b0)
  *(.text.gx8002_xip_rtc_initialize_102066bc)
  *(.text.gx8002_xip_dma_initialize_10203bc0)
  *(.text.gx8002_xip_board_pin_initialize_102068a0)
  *(.text.gx8002_xip_uart_initialize_10203530)
  *(.text.gx8002_xip_board_pin_setup_1020681c)
  *(.text.gx8002_xip_power_initialize_10207680)
  *(.text.gx8002_xip_board_pin_configure_102067dc)
  *(.text.gx8002_xip_padmux_get_1020658c)
  *(.text.gx8002_xip_padmux_check_102065b8)
  *(.text.gx8002_xip_padmux_set_102065dc)
  *(.text.gx8002_xip_padmux_initialize_10206630)
  *(.text.gx8002_xip_gpio_set_direction_10205f24)
  *(.text.gx8002_xip_print_max_kws_list_10208880)
  *(.text.gx8002_xip_dma_isr_10203adc)
  *(.text.gx8002_xip_dma_clear_10203804)
  *(.text.gx8002_xip_dma_deallocate_10203a98)
  *(.text.gx8002_xip_uart_configure_102033c8)
  *(.text.gx8002_xip_uart_fifo_depth_10203360)
  *(.text.gx8002_xip_uart_isr_10203278)
  *(.text.gx8002_xip_spi_master_probe_10206480)
  *(.text.gx8002_xip_spi_register_master_102060fc)
  *(.text.gx8002_xip_spi_cleanup_10206164)
  *(.text.gx8002_xip_spi_isr_10206170)
  *(.text.gx8002_xip_spi_setup_10206190)
  *(.text.gx8002_xip_spi_quick_transfer_10206204)
  *(.text.gx8002_xip_max_score_102086dc)
  *(.text.gx8002_xip_kws_insert_activation_10208980)
  *(.text.gx8002_xip_bunkws_offset_10208b58)
  *(.text.gx8002_xip_bunkws_offset_clear_10208b68)
  *(.text.gx8002_xip_bionic_run_10208b78)
  *(.text.gx8002_xip_uart_async_register_102082ac)
  *(.text.gx8002_xip_uart_async_initialize_10208458)
  *(.text.gx8002_xip_uart_channel_lookup_10207ac0)
  *(.text.gx8002_xip_uart_transmit_abort_dma_1020321c)
  *(.text.gx8002_xip_uart_receive_abort_dma_10203234)
  *(.text.gx8002_xip_uart_transmit_abort_102036e8)
  *(.text.gx8002_xip_uart_receive_abort_10203704)
  *(.text.gx8002_xip_uart_receive_start_1020368c)
  *(.text.gx8002_xip_uart_receive_stop_102036c0)
  *(.text.gx8002_xip_power_lock_create_10207770)
  *(.text.gx8002_xip_uart_message_suspend_10207c74)
  *(.text.gx8002_xip_uart_message_resume_10207c9c)
  *(.text.gx8002_xip_dma_abort_10203b40)
  *(.text.gx8002_xip_dma_release_10203b38)
  *(.text.gx8002_xip_aout_get_mute_10204cd4)
  *(.text.gx8002_xip_register_get_bit_102055c0)
  *(.text.gx8002_xip_gsensor_workstate_10206908)
  *(.text.gx8002_xip_ctc_model_output_10208c60)
  *(.text.gx8002_xip_uart_flush_10203598)
  *(.text.gx8002_xip_power_unlock_102077d4)
  *(.text.gx8002_xip_uart_read_102035d8)
  *(.text.gx8002_xip_uart_receive_callback_10208098)
  *(.text.gx8002_xip_uart_body_probe_10207cec)
  *(.text.gx8002_xip_uart_receive_buffer_10203780)
  *(.text.gx8002_xip_uart_receive_body_done_10207ee0)
  *(.text.gx8002_xip_uart_receive_complete_102030e4)
  *(.text.gx8002_xip_dma_select_10203a4c)
  *(.text.gx8002_xip_dma_callback_10203b64)
  *(.text.gx8002_xip_uart_receive_dma_10203190)
  *(.text.gx8002_xip_dma_transfer_10203b78)
  *(.text.gx8002_xip_virt_to_dma_10203c60)
  *(.text.gx8002_xip_dma_descriptors_10203828)
  *(.text.gx8002_xip_dma_configure_102038f4)
  *(.text.gx8002_xip_uart_message_body_10207b38)
  *(.text.gx8002_xip_uart_body_done_10207c50)
  *(.text.gx8002_xip_uart_send_callback_10207f08)
  *(.text.gx8002_xip_uart_write_10203604)
  *(.text.gx8002_xip_uart_transmit_start_10203630)
  *(.text.gx8002_xip_uart_transmit_stop_10203664)
  *(.text.gx8002_xip_uart_transmit_buffer_10203720)
  *(.text.gx8002_xip_uart_transmit_complete_102030c4)
  *(.text.gx8002_xip_uart_transmit_dma_entry_10203108)
  *(.text.gx8002_xip_crc32_102098a8)
  *(.text.gx8002_xip_aout_frame_over_enable_102049c8)
  *(.text.gx8002_xip_aout_play_check_idle_102049d8)
  *(.text.gx8002_xip_aout_handle_isr_102050cc)
  *(.text.gx8002_xip_aout_set_fixed_src_10204cdc)
  *(.text.gx8002_xip_aout_get_sdc_addr_10204cfc)
  *(.text.gx8002_xip_aout_drain_frame_10204d04)
  *(.text.gx8002_xip_aout_config_buffer_10204e6c)
  *(.text.gx8002_xip_aout_set_mute_1020508c)
  *(.text.gx8002_xip_aout_config_i2s_10204c64)
  *(.text.gx8002_xip_aout_config_dac_10204c90)
  *(.text.gx8002_xip_aout_i2s_config_10204ab0)
  *(.text.gx8002_xip_aout_dac_config_102049e8)
  *(.text.gx8002_xip_aout_set_lodac_10204b5c)
  *(.text.gx8002_xip_aout_config_pcm_10204d38)
  *(.text.gx8002_xip_aout_free_102052e0)
  *(.text.gx8002_xip_aout_config_cb_10205318)
  *(.text.gx8002_xip_aout_exit_10205344)
  *(.text.gx8002_xip_audio_channel_field_102049b0)
  *(.text.gx8002_xip_aout_suspend_10204ec0)
  *(.text.gx8002_xip_aout_resume_1020521c)
  *(.text.gx8002_xip_npu_get_interrupt_102056f0)
  *(.text.gx8002_xip_npu_clear_without_overflow_102057e0)
  *(.text.gx8002_xip_npu_clear_overflow_10205838)
  *(.text.gx8002_xip_npu_get_overflow_command_10205870)
  *(.text.gx8002_xip_npu_get_task_head_102058a4)
  *(.text.gx8002_xip_npu_get_base_address_102058b4)
  *(.text.gx8002_xip_npu_get_current_command_102058c4)
  *(.text.gx8002_xip_snpu_isr_10205ce0)
  *(.text.gx8002_xip_snpu_process_status_10205bd8)
  *(.text.gx8002_xip_snpu_dump_words_10205ad8)
  *(.text.gx8002_xip_snpu_overtime_reset_10205b1c)
  *(.text.gx8002_xip_gpio_isr_10205ee0)
  *(.text.gx8002_xip_gpio_enable_trigger_10205fb4)
  *(.text.gx8002_xip_gpio_disable_trigger_10206074)
  *(.text.gx8002_xip_uart_async_done_1020854c)
  *(.text.gx8002_xip_vad_notify_1020979c)
  *(.text.gx8002_xip_notification_poll_102097c8)
  *(.text.gx8002_xip_multiboot_switch_10207a80)
  *(.text.gx8002_xip_aout_push_frame_102051a8)
  *(.text.gx8002_xip_aout_set_channel_1020502c)
  *(.text.gx8002_xip_aout_set_db_10204f90)
  *(.text.gx8002_xip_aout_get_db_10204ff0)
  *(.text.gx8002_xip_aout_hw_initialize_10204f18)
  *(.text.gx8002_xip_aout_select_hw_config_10205374)
  *(.text.gx8002_xip_audio_out_alloc_playback_1020537c)
  *(.text.gx8002_xip_audio_out_free_102053b0)
  *(.text.gx8002_xip_audio_out_config_buffer_102053e4)
  *(.text.gx8002_xip_audio_out_config_pcm_10205418)
  *(.text.gx8002_xip_audio_out_config_cb_10205450)
  *(.text.gx8002_xip_audio_out_push_frame_10205488)
  *(.text.gx8002_xip_audio_out_set_db_102054c0)
  *(.text.gx8002_xip_audio_out_set_channel_102054f8)
  *(.text.gx8002_xip_audio_out_init_10205530)
  *(.text.gx8002_xip_audio_out_exit_10205574)
  *(.text.gx8002_xip_aout_alloc_playback_10205254)
  *(.text.gx8002_xip_app_gpio_event_10208e20)
  *(.text.gx8002_xip_audio_range_callback_10208d98)
  *(.text.gx8002_xip_app_gpio_suspend_10208dcc)
  *(.text.gx8002_xip_app_gpio_resume_10208dec)
  *(.text.gx8002_xip_notification_setup_102096fc)
  *(.text.gx8002_xip_sample_app_init_10208e4c)
  *(.text.gx8002_xip_app_commands_10209258)
  *(.text.gx8002_xip_mic_buffer_10208e80)
  *(.text.gx8002_xip_stop_i2s_1020913c)
  *(.text.gx8002_xip_start_i2s_10208ff0)
  *(.text.gx8002_xip_sample_event_10208f04)
  *(.text.gx8002_xip_i2s_request_tick_102091bc)
  *(.text.gx8002_xip_app_command_callback_persistent_10209430)
  *(.text.gx8002_xip_strtok_1020995c)
  *(.text.gx8002_xip_div64_102098b4)
  *(.text.gx8002_xip_unpack_double_1020a704)
  *(.text.gx8002_xip_fpcmp_parts_1020a7e8)
  *(.text.gx8002_xip_pack_double_1020a574)
  *(.text.gx8002_xip_fpadd_parts_10209dd8)
  *(.text.__fe_getround)
  *(.text.__fe_raise_inexact)
  *(.text.__adddf3)
  *(.text.__ashldi3)
  *(.text.__divdf3)
  *(.text.__fixunsdfsi)
  *(.text.__floatunsidf)
  *(.text.__muldf3)
  *(.text.__lshrdi3)
  *(.text.gx8002_xip_watchdog_ping_102067a0)
  *(.text.gx8002_xip_mode_tick_102085f8)
  *(.text.gx8002_xip_app_event_tick_10208d48)
  *(.text.gx8002_xip_uart_async_tick_10208334)
  *(.text.gx8002_xip_strncmp_10206c7c)
  *(.text.gx8002_xip_strlen_10206ca0)
  *(.text.gx8002_cache_lines)
  *(.text.crc32_no_comp)
  *(.text.crc32)
  *(.rodata.g2_codec_board_constant)
  *(.rodata.g2_codec_gain_table)
  *(.rodata.CSWTCH.5)
  *(.rodata.gx8002_xip_audio_vad_query_10207404.str1.4)
  *(.rodata.gx8002_xip_idle_descriptor)
  *(.rodata.gx8002_xip_mode_table)
  *(.rodata.gx8002_xip_tws_descriptor)
  *(.rodata.gx8002_xip_idle_done_10208624.str1.4)
  *(.rodata.gx8002_xip_idle_initialize_10208634.str1.4)
  *(.rodata.gx8002_xip_tws_done_1020864c.str1.4)
  *(.rodata.gx8002_xip_tws_initialize_10208670.str1.4)
  *(.rodata.gx8002_xip_app_initialize_10208cd4.str1.1)
  *(.rodata.gx8002_xip_watchdog_initialize_10206720.str1.1)
  *(.rodata.gx8002_xip_kws_flash_load_10206cb0.str1.4)
  *(.rodata.gx8002_xip_audio_board_initialize_10203024.str1.4)
  *(.rodata.correction.3097)
  *(.rodata.gx8002_xip_max_kws_initialize_10208944.str1.4)
  *(.rodata.gx8002_xip_tws_message_buffer_1020b250)
  *(.rodata.shifts.3123)
  *(.rodata.gx8002_xip_tws_command_10207808.str1.4)
  *(.rodata.gx8002_xip_kws_strategy_10208a10.str1.4)
  *(.rodata.gx8002_lvp_ldo_trim_mv)
  *(.rodata.gx8002_xip_lvp_system_initialize_102078a4.str1.1)
  *(.rodata.gx8002_xip_rtc_initialize_102066bc.str1.1)
  *(.rodata.gx8002_xip_board_pin_defaults_1020ad30)
  *(.rodata.gx8002_xip_board_pin_initialize_102068a0.str1.1)
  *(.rodata.gx8002_xip_board_pin_setup_1020681c.str1.4)
  *(.rodata.gx8002_xip_board_pin_configure_102067dc.str1.4)
  *(.rodata.gx8002_xip_padmux_defaults_1020acc4)
  *(.rodata.gx8002_xip_print_max_kws_list_10208880.str1.4)
  *(.rodata.gx8002_xip_uart_fifo_depth_10203360)
  *(.rodata.gx8002_xip_max_score_102086dc.str1.4)
  *(.rodata.gx8002_xip_bionic_run_10208b78.str1.1)
  *(.rodata.gx8002_xip_kws_insert_activation_10208980.str1.1)
  *(.rodata.gx8002_xip_uart_async_initialize_10208458.str1.1)
  *(.rodata.gx8002_xip_gsensor_workstate_10206908.str1.4)
  *(.rodata.stride_table.3099)
  *(.rodata.CSWTCH.2)
  *(.rodata.mismatch_format)
  *(.rodata.gx8002_xip_snpu_dump_words_10205ad8.str1.1)
  *(.rodata.gx8002_xip_snpu_overtime_reset_10205b1c.str1.1)
  *(.rodata.enable_offsets.3117)
  *(.rodata.offsets.3124)
  *(.rodata.gx8002_xip_vad_notify_1020979c.str1.1)
  *(.rodata.gx8002_xip_multiboot_switch_10207a80.str1.4)
  *(.rodata.channel_bits)
  *(.rodata.db_pairs)
  *(.rodata.gx8002_xip_audio_out_alloc_playback_1020537c.str1.1)
  *(.rodata.gx8002_xip_audio_out_config_buffer_102053e4.str1.1)
  *(.rodata.gx8002_xip_audio_out_config_cb_10205450.str1.1)
  *(.rodata.gx8002_xip_audio_out_config_pcm_10205418.str1.1)
  *(.rodata.gx8002_xip_audio_out_exit_10205574.str1.1)
  *(.rodata.gx8002_xip_audio_out_free_102053b0.str1.1)
  *(.rodata.gx8002_xip_audio_out_init_10205530.str1.1)
  *(.rodata.gx8002_xip_audio_out_push_frame_10205488.str1.1)
  *(.rodata.gx8002_xip_audio_out_set_channel_102054f8.str1.1)
  *(.rodata.gx8002_xip_audio_out_set_db_102054c0.str1.1)
  *(.rodata.gx8002_xip_app_gpio_event_10208e20.str1.4)
  *(.rodata.gx8002_xip_app_gpio_resume_10208dec.str1.4)
  *(.rodata.gx8002_xip_app_gpio_suspend_10208dcc.str1.4)
  *(.rodata.gx8002_xip_notification_setup_102096fc.str1.4)
  *(.rodata.gx8002_xip_sample_app_init_10208e4c.str1.4)
  *(.rodata.gx8002_xip_app_commands_10209258.str1.4)
  *(.rodata.identity.3106)
  *(.rodata.name.3107)
  *(.rodata.str1.4)
  *(.rodata.gx8002_xip_mic_buffer_10208e80.str1.1)
  *(.rodata.gx8002_xip_stop_i2s_1020913c.str1.4)
  *(.rodata.gx8002_xip_start_i2s_10208ff0.str1.4)
  *(.rodata.gx8002_xip_sample_event_10208f04.str1.1)
  *(.rodata.gx8002_xip_i2s_request_tick_102091bc.str1.4)
  *(.rodata.gx8002_xip_app_command_callback_persistent_10209430.str1.1)
  *(.rodata.opposite_infinity_nan_parts)
  *(.rodata.gx8002_xip_udivdi3_bit_length_1020bd1c)
  *(.rodata.llvm_mode.3091)
  *(.rodata.gx8002_xip_uart_async_tick_10208334.str1.4)
  *(.rodata.divider_modules.3156)
  *(.rodata.divider_values.3157)
  *(.rodata.source_modules.3150)
  *(.rodata.source_values.3151)
  *(.rodata.expected.3130)
  *(.gx8002.sample_name.b649)
  *(.gx8002.sample_name.b654)
  *(.gx8002.sample_name.b665)
  *(.gx8002.flash_name.be54)
  *(.gx8002.flash_name.be5c)
  *(.gx8002.flash_name.be64)
  *(.gx8002.flash_name.be6c)
  *(.gx8002.flash_name.be75)
  *(.gx8002.flash_name.be7e)
  *(.rodata.crc_table)
 }
}
