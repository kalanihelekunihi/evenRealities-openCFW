SECTIONS {
 .gx8002_resident_packed 0x10023400 : {
  *(.text)
  *(.text.gx8002_resident_vic_disable_irq_254c8)
  *(.text.gx8002_resident_irq_restore_enabled_254e4)
  *(.text.gx8002_resident_mask_irq_254fc)
  *(.text.gx8002_resident_unmask_irq_25504)
  *(.text.gx8002_resident_irq_save_disable_2550c)
  *(.text.gx8002_resident_irq_save_disable_wrapper_25534)
  *(.text.gx8002_resident_clock_time_us_2585c)
  *(.text.gx8002_resident_flash_gettype_24244)
  *(.text.gx8002_resident_clock_subband_hz_25e38)
  *(.text.gx8002_resident_flash_type_api_247d4)
  *(.text.gx8002_resident_flash_wait_bus_2364c)
  *(.text.gx8002_resident_flash_wait_rx_empty_2365c)
  *(.text.gx8002_resident_flash_command_read_23684)
  *(.text.gx8002_resident_flash_discover_24190)
  *(.text.gx8002_resident_flash_wait_tx_empty_23670)
  *(.text.gx8002_resident_flash_command_write_236dc)
  *(.text.gx8002_resident_flash_read_status_23734)
  *(.text.gx8002_resident_flash_write_enable_2374c)
  *(.text.gx8002_resident_flash_wait_ready_2375c)
  *(.text.gx8002_resident_flash_read_status2_23770)
  *(.text.gx8002_resident_flash_quad_enable_242b4)
  *(.text.gx8002_resident_flash_quad_enable_pair_24330)
  *(.text.gx8002_resident_flash_read_2381c)
  *(.text.gx8002_resident_flash_getinfo_23858)
  *(.text.gx8002_resident_flash_word_program_23788)
  *(.text.gx8002_resident_flash_word_read_23cac)
  *(.text.gx8002_resident_flash_write_protect_mode_23980)
  *(.text.gx8002_resident_flash_block_bounds_238a4)
  *(.text.gx8002_resident_flash_write_protect_status_238ec)
  *(.text.gx8002_resident_flash_write_protect_set_239a4)
  *(.text.gx8002_resident_flash_write_protect_lock_23a70)
  *(.text.gx8002_resident_flash_write_protect_unlock_23a80)
  *(.text.gx8002_resident_flash_block_range_23a90)
  *(.text.gx8002_resident_flash_sync_23ab8)
  *(.text.gx8002_resident_flash_device_config_242ec)
  *(.text.gx8002_resident_xip_initialize_2436c)
  *(.text.gx8002_resident_flash_initialize_245f0)
  *(.text.gx8002_resident_platform_config_25d74)
  *(.text.gx8002_resident_platform_read_24810)
  *(.text.gx8002_resident_module_get_info_24a44)
  *(.text.gx8002_resident_platform_gate_25080)
  *(.text.gx8002_resident_clock_snpu_enable_251ec)
  *(.text.gx8002_resident_clock_module_query_24d70)
  *(.text.gx8002_resident_clock_gate_query_25180)
  *(.text.gx8002_resident_clock_frequency_25210)
  *(.text.gx8002_resident_trim_clock_enable_24a10)
  *(.text.gx8002_resident_trim_state_24a1c)
  *(.text.gx8002_resident_reg_set_val_24a30)
  *(.text.gx8002_resident_module_div_read_24ae8)
  *(.text.gx8002_resident_clock_source_select_24bcc)
  *(.text.gx8002_resident_clock_module_divider_24df8)
  *(.text.gx8002_resident_clock_module_dto_24f44)
  *(.text.gx8002_resident_clock_module_source_24be0)
  *(.text.gx8002_resident_clock_lowpower_init_2599c)
  *(.text.gx8002_resident_clock_pair_dividers_zero_25a00)
  *(.text.gx8002_resident_clock_switch_1m_25a14)
  *(.text.gx8002_resident_timer_channel_initialize_257b8)
  *(.text.gx8002_resident_timer_initialize_257e8)
  *(.text.gx8002_resident_tws_tick_26358)
  *(.text.gx8002_resident_tws_audio_callback_263dc)
  *(.text.gx8002_resident_audio_record_callback_26214)
  *(.text.gx8002_resident_audio_irq_core_25e48)
  *(.text.gx8002_resident_tws_callback_260d0)
  *(.text.gx8002_resident_tws_buffer_update_260e4)
  *(.text.gx8002_resident_clock_set_pll_24b04)
  *(.text.gx8002_resident_clock_pll_wait_25060)
  *(.text.gx8002_resident_clock_pll_wait_timeout_2500c)
  *(.text.gx8002_resident_analog_ldo_voltage_246f0)
  *(.text.gx8002_resident_analog_ldo_digital_state_24710)
  *(.text.gx8002_resident_system_initialize_2354c)
  *(.text.gx8002_resident_clock_init_pointer_25a88)
  *(.text.gx8002_resident_main_26314)
  *(.text.gx8002_resident_pmu_wakeup_source_24940)
  *(.text.gx8002_resident_board_initialize_25cbc)
  *(.text.gx8002_resident_flash_spi_irq_handler_23ac0)
  *(.text.gx8002_resident_flash_protection_initialize_246c4)
  *(.text.gx8002_resident_vic_enable_irq_254ac)
  *(.text.gx8002_resident_request_irq_2553c)
  *(.text.gx8002_resident_flash_interface_initialize_2443c)
  *(.text.gx8002_resident_flash_addr_to_command_23b8c)
  *(.text.gx8002_resident_flash_page_program_23c34)
  *(.text.gx8002_resident_flash_erase_23d58)
  *(.text.gx8002_resident_flash_chip_erase_23e00)
  *(.text.gx8002_resident_flash_otp_status_23ae0)
  *(.text.gx8002_resident_flash_otp_get_region_23b24)
  *(.text.gx8002_resident_flash_otp_set_region_23b38)
  *(.text.gx8002_resident_flash_otp_get_current_region_23b60)
  *(.text.gx8002_resident_flash_otp_get_region_size_23b78)
  *(.text.gx8002_resident_flash_otp_lock_24250)
  *(.text.gx8002_resident_flash_otp_mode_25d04)
  *(.text.gx8002_resident_otp_lowpower_enter_248cc)
  *(.text.gx8002_resident_flash_uid_read_24104)
  *(.text.gx8002_resident_flash_otp_transmit_23e14)
  *(.text.gx8002_resident_flash_otp_erase_23bd8)
  *(.text.gx8002_resident_flash_otp_write_23eb8)
  *(.text.gx8002_resident_flash_otp_read_23fa4)
  *(.text.gx8002_resident_flash_probe_2475c)
  *(.text.gx8002_resident_flash_dispatch_read_247b8)
  *(.text.gx8002_resident_flash_dispatch_getinfo_247e0)
  *(.text.gx8002_resident_flash_dispatch_otp_read_247f4)
  *(.text.gx8002_resident_timer_dispatch_258c4)
  *(.text.gx8002_resident_delay_us_25944)
  *(.text.gx8002_resident_delay_ms_2598c)
  *(.text.gx8002_resident_clear_bss_23528)
  *(.text.gx8002_resident_start_mode_24984)
  *(.text.gx8002_resident_memcpy_25738)
  *(.text.gx8002_resident_dcache_enable_255c4)
  *(.text.gx8002_resident_dcache_disable_255e4)
  *(.text.gx8002_resident_cache_invalidate_25608)
  *(.text.gx8002_resident_cache_clean_invalidate_256c0)
  *(.text.gx8002_resident_icache_enable_2571c)
  *(.text.gx8002_resident_kws_pair_260d0)
  *(.text.gx8002_resident_active_snpu_callback_26340)
  *(.text.gx8002_resident_tws_set_standby_263b4)
  *(.text.gx8002_resident_tws_standby_loop_263c4)
  *(.text.gx8002_resident_keyword_list_get_264dc)
  *(.rodata.gx8002_resident_flash_getinfo_23858)
  *(.rodata.gx8002_resident_platform_config_25d74)
  *(.rodata.gx8002_resident_platform_read_24810)
  *(.rodata.gx8002_resident_platform_gate_25080)
  *(.gx8002.clock_boot.25cd0)
  *(.gx8002.clock_boot.25ce0)
  *(.gx8002.vectors.23400)
  *(.rodata.gx8002_resident_flash_otp_mode_25d04.str1.1)
  *(.gx8002.clock_sources.26904)
  *(.gx8002.clock_sources.26954)
  *(.gx8002.clock_defaults.268c8)
  *(.gx8002.otp_protect.2657c)
  *(.gx8002.otp_protect.265a4)
  *(.gx8002.otp_protect.265dc)
  *(.gx8002.flash_catalog.26624)
  *(.gx8002.module_config.26880)
  *(.gx8002.module_table.266e0)
  *(.gx8002.sram.aout_operations)
  *(.gx8002.sram.aout_configuration)
  *(.gx8002.sram.aout_context)
  *(.gx8002.uart_channels.26a94)
  *(.gx8002.kws_keywords.26c7c)
  *(.gx8002.request_initial.26d5c)
  *(.gx8002.sample_prestate.26d2c)
  *(.gx8002.sample_registration.26d30)
  *(.gx8002.uart_rx_config.26c74)
  *(.gx8002.flash_api.26504)
  *(.gx8002.flash_state.264e4)
  *(.gx8002.board_state.269a4)
  *(.gx8002.flash_otp_config.266cc)
 }
}
