case_kernel_invariant_failure = 0x0010f001;
case_kernel_irq_save = 0x0010f101;
case_kernel_irq_restore = 0x0010f201;
case_queue_copy_in = 0x0010f301;
case_queue_wake = 0x0010f401;
case_kernel_yield = 0x0010f501;
case_kernel_enter = 0x0010f601;
case_kernel_exit = 0x0010f701;
case_kernel_mode = 0x0010f801;
case_kernel_timeout_start = 0x0010f901;
case_kernel_scheduler_suspend = 0x0010fa01;
case_kernel_timeout_check = 0x0010fb01;
case_queue_is_active = 0x0010fc01;
case_queue_unlock = 0x0010fd01;
case_queue_wait = 0x0010fe01;
case_kernel_scheduler_resume = 0x0010ff01;
SECTIONS { . = 0x00100000; .text : { *(.text*) *(.rodata*) } /DISCARD/ : { *(.ARM.exidx*) *(.comment*) } }
