case_init_boost_set = 0x0010f001;
case_init_display_reset = 0x0010f101;
case_init_hex_log = 0x0010f201;
case_init_id0 = 0x0010f301;
case_init_id1 = 0x0010f401;
case_init_id2 = 0x0010f501;
case_init_led_show = 0x0010f601;
case_init_log = 0x0010f701;
case_init_motion_read = 0x0010f801;
case_init_pin_read = 0x0010f901;
case_init_pmic_prepare = 0x0010fa01;
case_init_pmic_read = 0x0010fb01;
case_init_pmic_reset = 0x0010fc01;
case_init_pmic_write = 0x0010fd01;
case_init_power_set = 0x0010fe01;
case_init_read_product_byte = 0x0010ff01;
case_init_secondary_config_read = 0x00110001;
case_init_secondary_read = 0x00110101;
case_init_selfcheck_read = 0x00110201;
case_init_sensor_finish = 0x00110301;
case_init_sensor_prepare = 0x00110401;
case_init_service_ready = 0x00110501;
case_init_service_start = 0x00110601;
case_init_usb_reset = 0x00110701;
case_init_usb_reset_requested = 0x00110801;
case_init_wait = 0x00110901;
case_init_wake_clock = 0x00110a01;
case_init_wake_config = 0x00110b01;
case_init_wake_mask = 0x00110c01;
SECTIONS { . = 0x00100000; .text : { *(.text*) *(.rodata*) } /DISCARD/ : { *(.ARM.exidx*) *(.comment*) } }
