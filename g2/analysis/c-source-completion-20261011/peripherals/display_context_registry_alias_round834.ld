/* Authenticated Apollo RAM aliases; final image must reserve/initialize them. */
PROVIDE(audio_uart_display_lv_root = 0x2006f548);
PROVIDE(lv_global = 0x2006f548);
PROVIDE(audio_uart_master_schedule_queue = 0x200749d0);
PROVIDE(audio_uart_display_context_list_cell = 0x200746c8);
PROVIDE(audio_uart_display_context_active_cell = 0x200746cc);
PROVIDE(audio_uart_display_locale_index = 0x20000030);
PROVIDE(audio_uart_locale_data_en = 0x20001588);
PROVIDE(audio_uart_locale_data_de = 0x200017fc);
PROVIDE(audio_uart_locale_data_es = 0x20001a70);
PROVIDE(audio_uart_locale_data_fr = 0x20001ce4);
PROVIDE(audio_uart_locale_data_it = 0x20001f58);
PROVIDE(audio_uart_locale_data_ja = 0x200021cc);
PROVIDE(audio_uart_locale_data_zh_cn = 0x20002440);
PROVIDE(audio_uart_locale_data_zh_hk = 0x200026b4);
