/* Authenticated Apollo RAM aliases; final memory-map reservation pending. */
PROVIDE(audio_uart_display_lv_root = 0x2006f548);
PROVIDE(lv_global = 0x2006f548);
PROVIDE(audio_uart_master_schedule_queue = 0x200749d0);
PROVIDE(audio_uart_display_context_list_cell = 0x200746c8);
PROVIDE(audio_uart_display_context_active_cell = 0x200746cc);
PROVIDE(audio_uart_display_locale_index = 0x20000030);
