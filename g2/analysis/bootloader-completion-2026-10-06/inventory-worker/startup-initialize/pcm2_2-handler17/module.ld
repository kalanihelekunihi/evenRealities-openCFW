ENTRY(opencfw_spot_pcm22_transition17)
SECTIONS {
  . = 0x00030000;
  .text : { *(.text .text.*) }
  .rodata : { *(.rodata .rodata.*) }
  .data : { *(.data .data.*) }
  .bss : { *(.bss .bss.* COMMON) }
}
